## firmware/esp32/main/Kconfig.projbuild
```kconfig
menu "ForgeSense AI"

config FORGESENSE_UART_PORT
    int "FPGA link UART port"
    range 1 2
    default 1

config FORGESENSE_UART_TX_GPIO
    int "FPGA link TX GPIO"
    range 0 48
    default 17

config FORGESENSE_UART_RX_GPIO
    int "FPGA link RX GPIO"
    range 0 48
    default 18

config FORGESENSE_UART_BAUD
    int "FPGA link baud rate"
    range 9600 2000000
    default 115200

config FORGESENSE_EVENT_RING_SIZE
    int "Persistent critical-event ring size"
    range 16 256
    default 64

config FORGESENSE_LINK_LOSS_MS
    int "Sensor link loss detection interval in milliseconds"
    range 250 30000
    default 2000

config FORGESENSE_TELEMETRY_ENABLE
    bool "Emit read-only host telemetry records"
    default y
    help
        Emit @FS1 JSON monitoring records to ESP-IDF standard output. This
        transport is diagnostic-only and never reads actuator/control commands.

config FORGESENSE_TELEMETRY_PERIOD_MS
    int "Host telemetry publication interval in milliseconds"
    depends on FORGESENSE_TELEMETRY_ENABLE
    range 100 10000
    default 500
    help
        Periodic publication interval. Important FPGA state transitions may
        cause an earlier record so the dashboard does not wait for this period.

endmenu
```

## firmware/esp32_calibration_maintenance/main/Kconfig.projbuild
```kconfig
menu "ForgeSense calibration maintenance"

config FORGESENSE_MAINTENANCE_ENABLE_GPIO
    int "Physical maintenance-enable GPIO"
    range -1 48
    default -1
    help
        GPIO carrying the physical maintenance-enable signal. Leave at -1 to
        disable provisioning completely. Assign this only after board wiring is
        frozen and reviewed.

config FORGESENSE_MAINTENANCE_ENABLE_ACTIVE_LEVEL
    int "Maintenance-enable asserted logic level"
    range 0 1
    default 0

config FORGESENSE_LOAD_INHIBIT_SENSE_GPIO
    int "Physical load-inhibit sense GPIO"
    range -1 48
    default -1
    help
        Independent GPIO proving the protected load output is physically
        inhibited during calibration maintenance. Leave at -1 to disable
        provisioning completely.

config FORGESENSE_LOAD_INHIBIT_ACTIVE_LEVEL
    int "Load-inhibit asserted logic level"
    range 0 1
    default 1

endmenu
```

## firmware/esp32_calibration_maintenance/sdkconfig.defaults
```kconfig
CONFIG_COMPILER_CXX_EXCEPTIONS=n
CONFIG_COMPILER_CXX_RTTI=n
CONFIG_ESP_MAIN_TASK_STACK_SIZE=6144
CONFIG_LOG_DEFAULT_LEVEL_NONE=y
CONFIG_ESP_CONSOLE_NONE=y
```
